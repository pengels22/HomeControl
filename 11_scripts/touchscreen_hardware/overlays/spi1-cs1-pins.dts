/*
 * Source: Travel_Laser/backend/config/overlays/spi1-cs1-pins.dts
 * Validated source commit: 76cfc35eab04d1f629762a393e66dc1d23979c06
 *
 * Commissioning-only overlay. Do not install automatically from HomeControl.
 */
/dts-v1/;
/plugin/;

/ {
    compatible = "allwinner,sun50i-h618", "allwinner,sun50i-h616";

    fragment@0 {
        target = <&spi1>;
        __overlay__ {
            pinctrl-names = "default";
            pinctrl-0 = <&spi1_pins &spi1_cs1_pin>;
            status = "okay";
        };
    };
};
